## teddybox/components/toniebox/Kconfig.projbuild
```kconfig
menu "Toniebox Hardware Revision"

choice CUSTOMER_AUDIO_BOARD
    prompt "Toniebox revision"
    default TONIEBOX_ESP32_V1_6_C
    help
        Select an audio board to use with the ESP-ADF

config TONIEBOX_ESP32_V1_6_C
    bool "Toniebox ESP32 v1.6.C"

endchoice

endmenu
```

## teddybox/sdkconfig.defaults
```kconfig
CONFIG_IDF_CMAKE=y
CONFIG_IDF_TARGET_ARCH_XTENSA=y
CONFIG_IDF_TARGET="esp32s3"
CONFIG_IDF_TARGET_ESP32S3=y
CONFIG_IDF_FIRMWARE_CHIP_ID=0x0009
CONFIG_SDK_TOOLPREFIX="xtensa-esp32s3-elf-"


CONFIG_BOOTLOADER_OFFSET_IN_FLASH=0x0000
CONFIG_PARTITION_TABLE_OFFSET=0x9000

CONFIG_PARTITION_TABLE_CUSTOM=y
CONFIG_PARTITION_TABLE_CUSTOM_FILENAME="part.lst"
CONFIG_PARTITION_TABLE_FILENAME="part.lst"

CONFIG_TONIEBOX_ESP32_V1_6_C=y
CONFIG_AUDIO_BOARD_CUSTOM=y


CONFIG_ESPTOOLPY_BAUD_921600B=y
CONFIG_ESPTOOLPY_FLASHMODE="qio"
CONFIG_ESPTOOLPY_BAUD=921600
CONFIG_ESPTOOLPY_FLASHSIZE_8MB=y
CONFIG_ESPTOOLPY_FLASHSIZE="8MB"


CONFIG_BOOTLOADER_APP_TEST=y
CONFIG_BOOTLOADER_NUM_PIN_APP_TEST=20
CONFIG_BOOTLOADER_HOLD_TIME_GPIO=5
```
